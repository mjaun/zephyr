## boards/arm/stm32h753i_eval/Kconfig.board
```kconfig
# STM32H753XI evaluation board configuration

# Copyright (c) 2021 Blue Clover Devices
# SPDX-License-Identifier: Apache-2.0

config BOARD_STM32H753I_EVAL
	bool "STM32H753XI Evaluation Board"
	depends on SOC_STM32H753XX
```

## boards/arm/stm32h753i_eval/Kconfig.defconfig
```kconfig
# STM32H753XI evaluation board configuration

# Copyright (c) 2021 Blue Clover Devices
# SPDX-License-Identifier: Apache-2.0

if BOARD_STM32H753I_EVAL

config BOARD
	default "stm32h753i_eval"

if NETWORKING

config NET_L2_ETHERNET
	default y

endif # NETWORKING

endif # BOARD_STM32H753I_EVAL
```

## boards/arm/stm32h753i_eval2/Kconfig.board
```kconfig
# STM32H753I_EVAL2 board configuration

# Copyright (c) 2021 Blue Clover Devices
# SPDX-License-Identifier: Apache-2.0

config BOARD_STM32H753I_EVAL2
	bool "STM32H753I_EVAL2 Development Board"
	depends on SOC_STM32H753XX
```

## boards/arm/stm32h753i_eval2/Kconfig.defconfig
```kconfig
# STM32H753I_EVAL2 board configuration

# Copyright (c) 2021 Blue Clover Devices
# SPDX-License-Identifier: Apache-2.0

if BOARD_STM32H753I_EVAL2

config BOARD
	default "stm32h753i_eval2"

if NETWORKING

config NET_L2_ETHERNET
	default y

endif # NETWORKING

endif # BOARD_STM32H753I_EVAL2
```

## drivers/input/Kconfig.exc7200
```kconfig
# Copyright (c) 2023 Antmicro <www.antmicro.com>
# SPDX-License-Identifier: Apache-2.0

config INPUT_EXC7200
	bool "EXC7200 touch driver"
	default y
	depends on DT_HAS_EETI_EXC7200_ENABLED
	select I2C
	help
	  Enable driver for EXC7200 touch panel.
```

## dts/bindings/input/eeti,exc7200.yaml
```yaml
# Copyright (c) 2023 Antmicro <www.antmicro.com>
# SPDX-License-Identifier: Apache-2.0

description: EXC7200 I2C touchscreen controller

compatible: "eeti,exc7200"

include: i2c-device.yaml

properties:
  screen-width:
    type: int
    default: 0
    description: |
      Screen width for scaling the reported coordinates.
      Default: raw touchscreen resolution.

  screen-height:
    type: int
    default: 0
    description: |
      Screen height for scaling the reported coordinates.
      Default: raw touchscreen resolution.
```
