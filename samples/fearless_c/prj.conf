## CMakeLists.txt
```
cmake_minimum_required(VERSION 3.20.0)
find_package(Zephyr REQUIRED HINTS $ENV{ZEPHYR_BASE})
project(fearless_c)

target_sources(app PRIVATE
        src/main.c
        src/wifi.c
        src/udp.c
        src/measurement.c
        src/serializer.c
        src/device.c
)
```

## prj.conf
```kconfig
CONFIG_LOG=y
CONFIG_LOG_MODE_IMMEDIATE=y

CONFIG_CBPRINTF_FP_SUPPORT=y

CONFIG_INIT_STACKS=y

CONFIG_POWEROFF=y

CONFIG_JSON_LIBRARY=y

CONFIG_SENSOR=y

CONFIG_WIFI=y
CONFIG_NET_L2_WIFI_MGMT=y

CONFIG_NETWORKING=y
CONFIG_NET_IPV4=y
CONFIG_NET_IPV6=n
CONFIG_NET_ARP=y
CONFIG_NET_UDP=y
CONFIG_NET_TCP=y
CONFIG_NET_DHCPV4=y
CONFIG_NET_SOCKETS=y

CONFIG_NET_MGMT=y
CONFIG_NET_MGMT_EVENT=y

CONFIG_DNS_RESOLVER=y

# Added to prevent error with missing #include <ethernet/eth_stats.h> for esp_wifi_drv.c
CONFIG_NET_L2_ETHERNET=y
```

## src/main.c
```c
#include "wifi.h"
#include "udp.h"
#include "measurement.h"
#include "serializer.h"
#include "device.h"
#include <zephyr/kernel.h>
#include <zephyr/logging/log.h>

LOG_MODULE_REGISTER(main);

int main(void)
{
	device_schedule_wakeup(10);

	uint64_t device_id = device_id_get();
	float temperature;

	if (measurement_get(&temperature) != 0) {
		goto teardown;
	}

	LOG_INF("Device ID:   0x%llx", device_id);
	LOG_INF("Temperature: %.3f C", (double) temperature);

	struct measurement measurement = {
		.device_id = device_id,
		.temperature = temperature,
	};

	char measurement_json[256];

	if (serializer_encode_measurement(&measurement, measurement_json, sizeof(measurement_json)) != 0) {
		goto teardown;
	}

	LOG_INF("%s", measurement_json);

	wifi_init();

	if (wifi_connect() != 0) {
		goto teardown;
	}

	if (udp_init() != 0) {
		goto disconnect;
	}

	(void) udp_send(measurement_json, strlen(measurement_json));

	// not sure how to properly wait until the UDP data has been sent
	k_sleep(K_SECONDS(3));

disconnect:
	wifi_disconnect();

teardown:
	device_deep_sleep();
}
```

## src/device.c
```c
#include "device.h"
#include <zephyr/drivers/w1.h>
#include <zephyr/logging/log.h>
#include <zephyr/sys/poweroff.h>
#include <esp_sleep.h>

LOG_MODULE_REGISTER(device);

uint64_t device_id_get()
{
    const struct device* w1 = DEVICE_DT_GET(DT_NODELABEL(w1));
    struct w1_rom rom = {0};

    (void) w1_reset_bus(w1);
    (void) w1_read_rom(w1, &rom);

    return w1_rom_to_uint64(&rom);
}

void device_schedule_wakeup(int seconds)
{
    esp_sleep_enable_timer_wakeup(seconds * 1000000ULL);
}

void device_deep_sleep()
{
    LOG_INF("Entering deep sleep");
	sys_poweroff();
}
```

## src/measurement.c
```c
#include "measurement.h"
#include <zephyr/kernel.h>
#include <zephyr/device.h>
#include <zephyr/devicetree.h>
#include <zephyr/drivers/sensor.h>
#include <zephyr/logging/log.h>

LOG_MODULE_REGISTER(measurement);

#define SENSOR_NODE   DT_ALIAS(temp_sensor)

static const struct device *sensor_dev = DEVICE_DT_GET(SENSOR_NODE);

int measurement_get(float *temperature)
{
    struct sensor_value temp;

    if (!device_is_ready(sensor_dev)) {
        LOG_ERR("Sensor device not ready!");
        return -ENODEV;
    }

    int ret = sensor_sample_fetch(sensor_dev);

    if (ret != 0) {
        LOG_ERR("Sample fetch failed: %d", ret);
        return ret;
    }

    ret = sensor_channel_get(sensor_dev, SENSOR_CHAN_AMBIENT_TEMP, &temp);

    if (ret != 0) {
        LOG_ERR("Channel get failed: %d", ret);
        return ret;
    }

    *temperature = (float) temp.val1 + ((float) temp.val2 * 0.000001f);
    return 0;
}
```

## src/serializer.c
```c
#include "serializer.h"
#include <zephyr/kernel.h>
#include <zephyr/data/json.h>
#include <zephyr/logging/log.h>

LOG_MODULE_REGISTER(serializer);

struct measurement_json {
    const char* device_id;
    struct json_obj_token temperature;
};

static const struct json_obj_descr measurement_descr[] = {
    JSON_OBJ_DESCR_PRIM(struct measurement_json, device_id, JSON_TOK_STRING),
    JSON_OBJ_DESCR_PRIM(struct measurement_json, temperature, JSON_TOK_FLOAT),
};

int serializer_encode_measurement(const struct measurement *measurement, char *buffer, size_t buffer_size)
{
    char id_buf[32] = {0};
    sprintf(id_buf, "%llx", measurement->device_id);

    char temp_buf[32] = {0};
    int temp_len = sprintf(temp_buf, "%.3f", (double) measurement->temperature);

    struct measurement_json measurement_json = {
        .device_id = id_buf,
        .temperature = { .start = temp_buf, .length = temp_len },
    };

    int ret = json_obj_encode_buf(
        measurement_descr,
        ARRAY_SIZE(measurement_descr),
        &measurement_json,
        buffer,
        buffer_size
    );

    if (ret != 0) {
        LOG_ERR("Serialization failed: %d", ret);
        return ret;
    }

    return 0;
}
```

## src/serializer.h
```c
#pragma once

#include <stdint.h>
#include <stdlib.h>

struct measurement {
    uint64_t device_id;
    float temperature;
};

int serializer_encode_measurement(const struct measurement* measurement, char* buffer, size_t buffer_size);
```

## src/udp.h
```c
#pragma once

#include <stdlib.h>

int udp_init(void);
int udp_send(const void* payload, size_t length);
```
